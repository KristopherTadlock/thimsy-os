## linux/Config.in
```kconfig
# Thimsy Base (BR2_EXTERNAL name THIMSY). Options that are not packages come
# first; the packages are in package/Config.in, and the recipes ported from GPL
# sources in gpl/package/Config.in (linux/gpl/README.md).

menu "Thimsy image"

choice
	prompt "Image flavour"
	default BR2_THIMSY_FLAVOUR_RELEASE
	help
	  Which services and access an image carries. configs/
	  targets.json picks it per target through dev.fragment or
	  release.fragment; tools/defconfig.py --check refuses a
	  publishable target that is not a release (decision I37).

config BR2_THIMSY_FLAVOUR_RELEASE
	bool "release"
	help
	  No adbd, no serial getty, the root password locked, SSH
	  off until the user turns it on (then root's password is
	  thimsy or the user's, local network only by default; OA-3).

config BR2_THIMSY_FLAVOUR_DEV
	bool "development"
	help
	  adbd, a serial console, SSH at boot with password logins,
	  root login allowed. Never published.

endchoice

endmenu

source "$BR2_EXTERNAL_THIMSY_PATH/package/Config.in"
source "$BR2_EXTERNAL_THIMSY_PATH/gpl/package/Config.in"
```

## linux/package/Config.in
```kconfig
# Every package of IMPLEMENTATION.md E.3. One "source" line per package; the
# recipes (<pkg>.mk, <pkg>.hash) are G2d's. test_defconfig.py checks that every
# package directory is sourced here.

menu "Thimsy"
	source "$BR2_EXTERNAL_THIMSY_PATH/package/libthimsy/Config.in"
	source "$BR2_EXTERNAL_THIMSY_PATH/package/thimsy-nano/Config.in"
	source "$BR2_EXTERNAL_THIMSY_PATH/package/thimsy-data/Config.in"
	source "$BR2_EXTERNAL_THIMSY_PATH/package/thimsy-session/Config.in"
	source "$BR2_EXTERNAL_THIMSY_PATH/package/thimsy-padd/Config.in"
	source "$BR2_EXTERNAL_THIMSY_PATH/package/thimsy-fonts/Config.in"
	source "$BR2_EXTERNAL_THIMSY_PATH/package/thimsy-gpu-pack/Config.in"
endmenu

menu "Emulators"
	source "$BR2_EXTERNAL_THIMSY_PATH/package/retroarch/Config.in"

	menu "libretro cores"
	comment "alpha set"
	source "$BR2_EXTERNAL_THIMSY_PATH/package/libretro-snes9x/Config.in"
	source "$BR2_EXTERNAL_THIMSY_PATH/package/libretro-genesis-plus-gx/Config.in"
	source "$BR2_EXTERNAL_THIMSY_PATH/package/libretro-picodrive/Config.in"
	source "$BR2_EXTERNAL_THIMSY_PATH/package/libretro-mgba/Config.in"
	source "$BR2_EXTERNAL_THIMSY_PATH/package/libretro-sameboy/Config.in"
	source "$BR2_EXTERNAL_THIMSY_PATH/package/libretro-mesen/Config.in"
	source "$BR2_EXTERNAL_THIMSY_PATH/package/libretro-fceumm/Config.in"
	source "$BR2_EXTERNAL_THIMSY_PATH/package/libretro-pcsx-rearmed/Config.in"
	comment "v1 set"
	source "$BR2_EXTERNAL_THIMSY_PATH/package/libretro-fbneo/Config.in"
	source "$BR2_EXTERNAL_THIMSY_PATH/package/libretro-mame2003-plus/Config.in"
	source "$BR2_EXTERNAL_THIMSY_PATH/package/libretro-mamearcade/Config.in"
	source "$BR2_EXTERNAL_THIMSY_PATH/package/libretro-stella/Config.in"
	source "$BR2_EXTERNAL_THIMSY_PATH/package/libretro-prosystem/Config.in"
	source "$BR2_EXTERNAL_THIMSY_PATH/package/libretro-a5200/Config.in"
	source "$BR2_EXTERNAL_THIMSY_PATH/package/libretro-gearcoleco/Config.in"
	source "$BR2_EXTERNAL_THIMSY_PATH/package/libretro-bluemsx/Config.in"
	source "$BR2_EXTERNAL_THIMSY_PATH/package/libretro-mednafen-vb/Config.in"
	source "$BR2_EXTERNAL_THIMSY_PATH/package/libretro-mednafen-ngp/Config.in"
	source "$BR2_EXTERNAL_THIMSY_PATH/package/libretro-mednafen-pce-fast/Config.in"
	source "$BR2_EXTERNAL_THIMSY_PATH/package/libretro-mednafen-wswan/Config.in"
	source "$BR2_EXTERNAL_THIMSY_PATH/package/libretro-mednafen-lynx/Config.in"
	source "$BR2_EXTERNAL_THIMSY_PATH/package/libretro-fake08/Config.in"
	source "$BR2_EXTERNAL_THIMSY_PATH/package/libretro-opera/Config.in"
	source "$BR2_EXTERNAL_THIMSY_PATH/package/libretro-yabasanshiro/Config.in"
	source "$BR2_EXTERNAL_THIMSY_PATH/package/libretro-mupen64plus-next/Config.in"
	source "$BR2_EXTERNAL_THIMSY_PATH/package/libretro-melondsds/Config.in"
	source "$BR2_EXTERNAL_THIMSY_PATH/package/libretro-flycast/Config.in"
	endmenu

	source "$BR2_EXTERNAL_THIMSY_PATH/package/ppsspp/Config.in"
	source "$BR2_EXTERNAL_THIMSY_PATH/package/scummvm/Config.in"
endmenu
```

## linux/package/libretro-a5200/Config.in
```kconfig
config BR2_PACKAGE_LIBRETRO_A5200
	bool "libretro-a5200"
	depends on BR2_PACKAGE_RETROARCH
	depends on BR2_TOOLCHAIN_HAS_THREADS
	help
	  The a5200 core for RetroArch: Atari 5200.

	  Set: v1 (IMPLEMENTATION.md E.3). Licence: GPL-2.0.

	  https://github.com/libretro/a5200

comment "libretro-a5200 needs a toolchain w/ threads"
	depends on BR2_PACKAGE_RETROARCH
	depends on !BR2_TOOLCHAIN_HAS_THREADS
```

## linux/package/libretro-bluemsx/Config.in
```kconfig
config BR2_PACKAGE_LIBRETRO_BLUEMSX
	bool "libretro-bluemsx"
	depends on BR2_PACKAGE_RETROARCH
	depends on BR2_TOOLCHAIN_HAS_THREADS
	help
	  The bluemsx core for RetroArch: MSX.

	  Set: v1 (IMPLEMENTATION.md E.3). Licence: GPL-2.0.

	  https://github.com/libretro/blueMSX-libretro

comment "libretro-bluemsx needs a toolchain w/ threads"
	depends on BR2_PACKAGE_RETROARCH
	depends on !BR2_TOOLCHAIN_HAS_THREADS
```

## linux/package/libretro-fake08/Config.in
```kconfig
config BR2_PACKAGE_LIBRETRO_FAKE08
	bool "libretro-fake08"
	depends on BR2_PACKAGE_RETROARCH
	depends on BR2_INSTALL_LIBSTDCPP
	depends on BR2_TOOLCHAIN_HAS_THREADS
	help
	  The fake08 core for RetroArch: PICO-8.

	  Set: v1 (IMPLEMENTATION.md E.3). Licence: MIT.

	  https://github.com/jtothebell/fake-08

comment "libretro-fake08 needs a toolchain w/ C++, threads"
	depends on BR2_PACKAGE_RETROARCH
	depends on !BR2_INSTALL_LIBSTDCPP || !BR2_TOOLCHAIN_HAS_THREADS
```

## linux/package/libretro-fbneo/Config.in
```kconfig
config BR2_PACKAGE_LIBRETRO_FBNEO
	bool "libretro-fbneo"
	depends on BR2_PACKAGE_RETROARCH
	depends on BR2_INSTALL_LIBSTDCPP
	depends on BR2_TOOLCHAIN_HAS_THREADS
	select BR2_PACKAGE_ZLIB
	help
	  The fbneo core for RetroArch: arcade (FinalBurn Neo).

	  Set: v1 (IMPLEMENTATION.md E.3). Licence: FBNeo licence (non-
	  commercial).

	  https://github.com/libretro/FBNeo

comment "libretro-fbneo needs a toolchain w/ C++, threads"
	depends on BR2_PACKAGE_RETROARCH
	depends on !BR2_INSTALL_LIBSTDCPP || !BR2_TOOLCHAIN_HAS_THREADS
```

## linux/package/libretro-fceumm/Config.in
```kconfig
config BR2_PACKAGE_LIBRETRO_FCEUMM
	bool "libretro-fceumm"
	depends on BR2_PACKAGE_RETROARCH
	depends on BR2_TOOLCHAIN_HAS_THREADS
	help
	  The fceumm core for RetroArch: NES and Famicom (wide mapper
	  coverage).

	  Set: alpha (IMPLEMENTATION.md E.3). Licence: GPL-2.0+.

	  https://github.com/libretro/libretro-fceumm

comment "libretro-fceumm needs a toolchain w/ threads"
	depends on BR2_PACKAGE_RETROARCH
	depends on !BR2_TOOLCHAIN_HAS_THREADS
```

## linux/package/libretro-flycast/Config.in
```kconfig
config BR2_PACKAGE_LIBRETRO_FLYCAST
	bool "libretro-flycast"
	depends on BR2_PACKAGE_RETROARCH
	depends on BR2_INSTALL_LIBSTDCPP
	depends on BR2_TOOLCHAIN_HAS_THREADS
	depends on BR2_PACKAGE_HAS_LIBGLES
	depends on BR2_PACKAGE_HAS_LIBEGL
	select BR2_PACKAGE_ZLIB
	help
	  The flycast core for RetroArch: Dreamcast.

	  Set: v1 (IMPLEMENTATION.md E.3). Licence: GPL-2.0.
	  Renders with OpenGL ES 3 (Panfrost on Mali).
	  Medium profile.

	  https://github.com/flyinghead/flycast

comment "libretro-flycast needs a toolchain w/ C++, threads"
	depends on BR2_PACKAGE_RETROARCH
	depends on !BR2_INSTALL_LIBSTDCPP || !BR2_TOOLCHAIN_HAS_THREADS
```

## linux/package/libretro-gearcoleco/Config.in
```kconfig
config BR2_PACKAGE_LIBRETRO_GEARCOLECO
	bool "libretro-gearcoleco"
	depends on BR2_PACKAGE_RETROARCH
	depends on BR2_INSTALL_LIBSTDCPP
	depends on BR2_TOOLCHAIN_HAS_THREADS
	help
	  The gearcoleco core for RetroArch: ColecoVision.

	  Set: v1 (IMPLEMENTATION.md E.3). Licence: GPL-3.0.

	  https://github.com/drhelius/Gearcoleco

comment "libretro-gearcoleco needs a toolchain w/ C++, threads"
	depends on BR2_PACKAGE_RETROARCH
	depends on !BR2_INSTALL_LIBSTDCPP || !BR2_TOOLCHAIN_HAS_THREADS
```

## linux/package/libretro-genesis-plus-gx/Config.in
```kconfig
config BR2_PACKAGE_LIBRETRO_GENESIS_PLUS_GX
	bool "libretro-genesis-plus-gx"
	depends on BR2_PACKAGE_RETROARCH
	depends on BR2_TOOLCHAIN_HAS_THREADS
	help
	  The genesis_plus_gx core for RetroArch: Sega Mega Drive, Mega-
	  CD, Master System and Game Gear.

	  Set: alpha (IMPLEMENTATION.md E.3). Licence: Genesis Plus GX
	  licence (non-commercial).

	  https://github.com/libretro/Genesis-Plus-GX

comment "libretro-genesis-plus-gx needs a toolchain w/ threads"
	depends on BR2_PACKAGE_RETROARCH
	depends on !BR2_TOOLCHAIN_HAS_THREADS
```

## linux/package/libretro-mame2003-plus/Config.in
```kconfig
config BR2_PACKAGE_LIBRETRO_MAME2003_PLUS
	bool "libretro-mame2003-plus"
	depends on BR2_PACKAGE_RETROARCH
	depends on BR2_TOOLCHAIN_HAS_THREADS
	select BR2_PACKAGE_ZLIB
	help
	  The mame2003_plus core for RetroArch: arcade (MAME 0.78 sets).

	  Set: v1 (IMPLEMENTATION.md E.3). Licence: MAME licence (non-
	  commercial).
	  The arcade default on 1 GB images (Q10).

	  https://github.com/libretro/mame2003-plus-libretro

comment "libretro-mame2003-plus needs a toolchain w/ threads"
	depends on BR2_PACKAGE_RETROARCH
	depends on !BR2_TOOLCHAIN_HAS_THREADS
```

## linux/package/libretro-mamearcade/Config.in
```kconfig
config BR2_PACKAGE_LIBRETRO_MAMEARCADE
	bool "libretro-mamearcade"
	depends on BR2_PACKAGE_RETROARCH
	depends on BR2_INSTALL_LIBSTDCPP
	depends on BR2_TOOLCHAIN_HAS_THREADS
	depends on BR2_TOOLCHAIN_GCC_AT_LEAST_10
	select BR2_PACKAGE_ZLIB
	help
	  The mamearcade core for RetroArch: arcade (current MAME,
	  arcade subtarget).

	  Set: v1 (IMPLEMENTATION.md E.3). Licence: GPL-2.0+.
	  The arcade default on 2 GB images (Q10); a long build.

	  https://github.com/libretro/mame

comment "libretro-mamearcade needs a toolchain w/ C++, threads, gcc >= 10"
	depends on BR2_PACKAGE_RETROARCH
	depends on !BR2_INSTALL_LIBSTDCPP || !BR2_TOOLCHAIN_HAS_THREADS || !BR2_TOOLCHAIN_GCC_AT_LEAST_10
```

## linux/package/libretro-mednafen-ngp/Config.in
```kconfig
config BR2_PACKAGE_LIBRETRO_MEDNAFEN_NGP
	bool "libretro-mednafen-ngp"
	depends on BR2_PACKAGE_RETROARCH
	depends on BR2_INSTALL_LIBSTDCPP
	depends on BR2_TOOLCHAIN_HAS_THREADS
	help
	  The mednafen_ngp core for RetroArch: Neo Geo Pocket (Beetle
	  NeoPop).

	  Set: v1 (IMPLEMENTATION.md E.3). Licence: GPL-2.0.

	  https://github.com/libretro/beetle-ngp-libretro

comment "libretro-mednafen-ngp needs a toolchain w/ C++, threads"
	depends on BR2_PACKAGE_RETROARCH
	depends on !BR2_INSTALL_LIBSTDCPP || !BR2_TOOLCHAIN_HAS_THREADS
```

## linux/package/libretro-mednafen-pce-fast/Config.in
```kconfig
config BR2_PACKAGE_LIBRETRO_MEDNAFEN_PCE_FAST
	bool "libretro-mednafen-pce-fast"
	depends on BR2_PACKAGE_RETROARCH
	depends on BR2_INSTALL_LIBSTDCPP
	depends on BR2_TOOLCHAIN_HAS_THREADS
	help
	  The mednafen_pce_fast core for RetroArch: PC Engine (Beetle
	  PCE Fast).

	  Set: v1 (IMPLEMENTATION.md E.3). Licence: GPL-2.0.

	  https://github.com/libretro/beetle-pce-fast-libretro

comment "libretro-mednafen-pce-fast needs a toolchain w/ C++, threads"
	depends on BR2_PACKAGE_RETROARCH
	depends on !BR2_INSTALL_LIBSTDCPP || !BR2_TOOLCHAIN_HAS_THREADS
```

## linux/package/libretro-mednafen-vb/Config.in
```kconfig
config BR2_PACKAGE_LIBRETRO_MEDNAFEN_VB
	bool "libretro-mednafen-vb"
	depends on BR2_PACKAGE_RETROARCH
	depends on BR2_INSTALL_LIBSTDCPP
	depends on BR2_TOOLCHAIN_HAS_THREADS
	help
	  The mednafen_vb core for RetroArch: Virtual Boy (Beetle VB).

	  Set: v1 (IMPLEMENTATION.md E.3). Licence: GPL-2.0.

	  https://github.com/libretro/beetle-vb-libretro

comment "libretro-mednafen-vb needs a toolchain w/ C++, threads"
	depends on BR2_PACKAGE_RETROARCH
	depends on !BR2_INSTALL_LIBSTDCPP || !BR2_TOOLCHAIN_HAS_THREADS
```

## linux/package/libretro-mednafen-wswan/Config.in
```kconfig
config BR2_PACKAGE_LIBRETRO_MEDNAFEN_WSWAN
	bool "libretro-mednafen-wswan"
	depends on BR2_PACKAGE_RETROARCH
	depends on BR2_INSTALL_LIBSTDCPP
	depends on BR2_TOOLCHAIN_HAS_THREADS
	help
	  The mednafen_wswan core for RetroArch: WonderSwan (Beetle
	  WonderSwan).

	  Set: v1 (IMPLEMENTATION.md E.3). Licence: GPL-2.0.

	  https://github.com/libretro/beetle-wswan-libretro

comment "libretro-mednafen-wswan needs a toolchain w/ C++, threads"
	depends on BR2_PACKAGE_RETROARCH
	depends on !BR2_INSTALL_LIBSTDCPP || !BR2_TOOLCHAIN_HAS_THREADS
```

## linux/package/libretro-melondsds/Config.in
```kconfig
config BR2_PACKAGE_LIBRETRO_MELONDSDS
	bool "libretro-melondsds"
	depends on BR2_PACKAGE_RETROARCH
	depends on BR2_INSTALL_LIBSTDCPP
	depends on BR2_TOOLCHAIN_HAS_THREADS
	depends on BR2_TOOLCHAIN_GCC_AT_LEAST_12
	depends on BR2_PACKAGE_HAS_LIBGLES
	depends on BR2_PACKAGE_HAS_LIBEGL
	select BR2_PACKAGE_ZLIB
	help
	  The melondsds core for RetroArch: Nintendo DS (melonDS DS).

	  Set: v1 (IMPLEMENTATION.md E.3). Licence: GPL-3.0.
	  Renders with OpenGL ES 3 (Panfrost on Mali).

	  https://github.com/JesseTG/melonds-ds

comment "libretro-melondsds needs a toolchain w/ C++, threads, gcc >= 12"
	depends on BR2_PACKAGE_RETROARCH
	depends on !BR2_INSTALL_LIBSTDCPP || !BR2_TOOLCHAIN_HAS_THREADS || !BR2_TOOLCHAIN_GCC_AT_LEAST_12
```

## linux/package/libretro-mesen/Config.in
```kconfig
config BR2_PACKAGE_LIBRETRO_MESEN
	bool "libretro-mesen"
	depends on BR2_PACKAGE_RETROARCH
	depends on BR2_INSTALL_LIBSTDCPP
	depends on BR2_TOOLCHAIN_HAS_THREADS
	help
	  The mesen core for RetroArch: NES and Famicom.

	  Set: alpha (IMPLEMENTATION.md E.3). Licence: GPL-3.0.

	  https://github.com/libretro/Mesen

comment "libretro-mesen needs a toolchain w/ C++, threads"
	depends on BR2_PACKAGE_RETROARCH
	depends on !BR2_INSTALL_LIBSTDCPP || !BR2_TOOLCHAIN_HAS_THREADS
```

## linux/package/libretro-mgba/Config.in
```kconfig
config BR2_PACKAGE_LIBRETRO_MGBA
	bool "libretro-mgba"
	depends on BR2_PACKAGE_RETROARCH
	depends on BR2_TOOLCHAIN_HAS_THREADS
	help
	  The mgba core for RetroArch: Game Boy Advance.

	  Set: alpha (IMPLEMENTATION.md E.3). Licence: MPL-2.0.

	  https://github.com/libretro/mgba

comment "libretro-mgba needs a toolchain w/ threads"
	depends on BR2_PACKAGE_RETROARCH
	depends on !BR2_TOOLCHAIN_HAS_THREADS
```

## linux/package/libretro-mupen64plus-next/Config.in
```kconfig
config BR2_PACKAGE_LIBRETRO_MUPEN64PLUS_NEXT
	bool "libretro-mupen64plus-next"
	depends on BR2_PACKAGE_RETROARCH
	depends on BR2_INSTALL_LIBSTDCPP
	depends on BR2_TOOLCHAIN_HAS_THREADS
	depends on BR2_PACKAGE_HAS_LIBGLES
	depends on BR2_PACKAGE_HAS_LIBEGL
	select BR2_PACKAGE_ZLIB
	help
	  The mupen64plus_next core for RetroArch: Nintendo 64.

	  Set: v1 (IMPLEMENTATION.md E.3). Licence: GPL-2.0.
	  Renders with OpenGL ES 3 (Panfrost on Mali).
	  Built with GLES3=1.

	  https://github.com/libretro/mupen64plus-libretro-nx

comment "libretro-mupen64plus-next needs a toolchain w/ C++, threads"
	depends on BR2_PACKAGE_RETROARCH
	depends on !BR2_INSTALL_LIBSTDCPP || !BR2_TOOLCHAIN_HAS_THREADS
```

## linux/package/libretro-opera/Config.in
```kconfig
config BR2_PACKAGE_LIBRETRO_OPERA
	bool "libretro-opera"
	depends on BR2_PACKAGE_RETROARCH
	depends on BR2_INSTALL_LIBSTDCPP
	depends on BR2_TOOLCHAIN_HAS_THREADS
	help
	  The opera core for RetroArch: 3DO.

	  Set: v1 (IMPLEMENTATION.md E.3). Licence: LGPL-2.1 and a non-
	  commercial licence.
	  Medium profile.

	  https://github.com/libretro/opera-libretro

comment "libretro-opera needs a toolchain w/ C++, threads"
	depends on BR2_PACKAGE_RETROARCH
	depends on !BR2_INSTALL_LIBSTDCPP || !BR2_TOOLCHAIN_HAS_THREADS
```
