## linux/package/libretro-pcsx-rearmed/Config.in
```kconfig
config BR2_PACKAGE_LIBRETRO_PCSX_REARMED
	bool "libretro-pcsx-rearmed"
	depends on BR2_PACKAGE_RETROARCH
	depends on BR2_TOOLCHAIN_HAS_THREADS
	help
	  The pcsx_rearmed core for RetroArch: PlayStation.

	  Set: alpha (IMPLEMENTATION.md E.3). Licence: GPL-2.0.

	  https://github.com/libretro/pcsx_rearmed

comment "libretro-pcsx-rearmed needs a toolchain w/ threads"
	depends on BR2_PACKAGE_RETROARCH
	depends on !BR2_TOOLCHAIN_HAS_THREADS
```

## linux/package/libretro-picodrive/Config.in
```kconfig
config BR2_PACKAGE_LIBRETRO_PICODRIVE
	bool "libretro-picodrive"
	depends on BR2_PACKAGE_RETROARCH
	depends on BR2_TOOLCHAIN_HAS_THREADS
	help
	  The picodrive core for RetroArch: Sega Mega Drive, Mega-CD and
	  32X.

	  Set: alpha (IMPLEMENTATION.md E.3). Licence: MAME-style
	  licence (non-commercial).

	  https://github.com/libretro/picodrive

comment "libretro-picodrive needs a toolchain w/ threads"
	depends on BR2_PACKAGE_RETROARCH
	depends on !BR2_TOOLCHAIN_HAS_THREADS
```

## linux/package/libretro-prosystem/Config.in
```kconfig
config BR2_PACKAGE_LIBRETRO_PROSYSTEM
	bool "libretro-prosystem"
	depends on BR2_PACKAGE_RETROARCH
	depends on BR2_TOOLCHAIN_HAS_THREADS
	help
	  The prosystem core for RetroArch: Atari 7800.

	  Set: v1 (IMPLEMENTATION.md E.3). Licence: GPL-2.0.

	  https://github.com/libretro/prosystem-libretro

comment "libretro-prosystem needs a toolchain w/ threads"
	depends on BR2_PACKAGE_RETROARCH
	depends on !BR2_TOOLCHAIN_HAS_THREADS
```

## linux/package/libretro-sameboy/Config.in
```kconfig
config BR2_PACKAGE_LIBRETRO_SAMEBOY
	bool "libretro-sameboy"
	depends on BR2_PACKAGE_RETROARCH
	depends on BR2_TOOLCHAIN_HAS_THREADS
	help
	  The sameboy core for RetroArch: Game Boy and Game Boy Color.

	  Set: alpha (IMPLEMENTATION.md E.3). Licence: MIT.

	  https://github.com/libretro/SameBoy

comment "libretro-sameboy needs a toolchain w/ threads"
	depends on BR2_PACKAGE_RETROARCH
	depends on !BR2_TOOLCHAIN_HAS_THREADS
```

## linux/package/libretro-snes9x/Config.in
```kconfig
config BR2_PACKAGE_LIBRETRO_SNES9X
	bool "libretro-snes9x"
	depends on BR2_PACKAGE_RETROARCH
	depends on BR2_INSTALL_LIBSTDCPP
	depends on BR2_TOOLCHAIN_HAS_THREADS
	help
	  The snes9x core for RetroArch: Super Nintendo.

	  Set: alpha (IMPLEMENTATION.md E.3). Licence: Snes9x licence
	  (non-commercial).

	  https://github.com/libretro/snes9x

comment "libretro-snes9x needs a toolchain w/ C++, threads"
	depends on BR2_PACKAGE_RETROARCH
	depends on !BR2_INSTALL_LIBSTDCPP || !BR2_TOOLCHAIN_HAS_THREADS
```

## linux/package/libretro-stella/Config.in
```kconfig
config BR2_PACKAGE_LIBRETRO_STELLA
	bool "libretro-stella"
	depends on BR2_PACKAGE_RETROARCH
	depends on BR2_INSTALL_LIBSTDCPP
	depends on BR2_TOOLCHAIN_HAS_THREADS
	help
	  The stella core for RetroArch: Atari 2600.

	  Set: v1 (IMPLEMENTATION.md E.3). Licence: GPL-2.0.

	  https://github.com/stella-emu/stella

comment "libretro-stella needs a toolchain w/ C++, threads"
	depends on BR2_PACKAGE_RETROARCH
	depends on !BR2_INSTALL_LIBSTDCPP || !BR2_TOOLCHAIN_HAS_THREADS
```

## linux/package/libretro-yabasanshiro/Config.in
```kconfig
config BR2_PACKAGE_LIBRETRO_YABASANSHIRO
	bool "libretro-yabasanshiro"
	depends on BR2_PACKAGE_RETROARCH
	depends on BR2_INSTALL_LIBSTDCPP
	depends on BR2_TOOLCHAIN_HAS_THREADS
	depends on BR2_PACKAGE_HAS_LIBGLES
	depends on BR2_PACKAGE_HAS_LIBEGL
	select BR2_PACKAGE_ZLIB
	help
	  The yabasanshiro core for RetroArch: Sega Saturn.

	  Set: v1 (IMPLEMENTATION.md E.3). Licence: GPL-2.0.
	  Renders with OpenGL ES 3 (Panfrost on Mali).
	  Medium profile; built with platform=arm64_cortex_a53_gles3.

	  https://github.com/libretro/yabause

comment "libretro-yabasanshiro needs a toolchain w/ C++, threads"
	depends on BR2_PACKAGE_RETROARCH
	depends on !BR2_INSTALL_LIBSTDCPP || !BR2_TOOLCHAIN_HAS_THREADS
```

## linux/package/libthimsy/Config.in
```kconfig
config BR2_PACKAGE_LIBTHIMSY
	bool "libthimsy"
	depends on BR2_INSTALL_LIBSTDCPP
	depends on BR2_TOOLCHAIN_HAS_THREADS
	depends on BR2_TOOLCHAIN_GCC_AT_LEAST_7 # C++17
	help
	  Thimsy's config store (Android-style properties with a
	  persist file), atomic files, the uevent parser and a small
	  JSON reader, as a static library in staging, plus the
	  thimsy-prop tool in the target. MIT.

	  Built from a git archive of the repository's libthimsy/ at
	  HEAD, which linux/build.sh writes (IMPLEMENTATION.md E.1).

comment "libthimsy needs a toolchain w/ C++, threads, gcc >= 7"
	depends on !BR2_INSTALL_LIBSTDCPP || !BR2_TOOLCHAIN_HAS_THREADS || \
		!BR2_TOOLCHAIN_GCC_AT_LEAST_7
```

## linux/package/ppsspp/Config.in
```kconfig
config BR2_PACKAGE_PPSSPP
	bool "ppsspp"
	depends on BR2_INSTALL_LIBSTDCPP
	depends on BR2_TOOLCHAIN_HAS_THREADS
	depends on BR2_TOOLCHAIN_GCC_AT_LEAST_9
	depends on BR2_PACKAGE_HAS_LIBEGL
	depends on BR2_PACKAGE_HAS_LIBGLES
	select BR2_PACKAGE_SDL2 # sdl2-compat on SDL3 when Thimsy adds it
	select BR2_PACKAGE_ZLIB
	select BR2_PACKAGE_LIBPNG
	help
	  PPSSPP, the PSP emulator, as the Android app's version
	  (1.20.4), with OpenGL ES and EGL through SDL; no Vulkan on
	  Mali. GPL-2.0+.

	  https://github.com/hrydgard/ppsspp

comment "ppsspp needs a toolchain w/ C++, threads, gcc >= 9"
	depends on !BR2_INSTALL_LIBSTDCPP || !BR2_TOOLCHAIN_HAS_THREADS || \
		!BR2_TOOLCHAIN_GCC_AT_LEAST_9

comment "ppsspp needs EGL and OpenGL ES"
	depends on !BR2_PACKAGE_HAS_LIBEGL || !BR2_PACKAGE_HAS_LIBGLES
```

## linux/package/retroarch/Config.in
```kconfig
config BR2_PACKAGE_RETROARCH
	bool "retroarch"
	depends on BR2_INSTALL_LIBSTDCPP
	depends on BR2_TOOLCHAIN_HAS_THREADS
	depends on BR2_PACKAGE_HAS_LIBEGL
	depends on BR2_PACKAGE_HAS_LIBGLES
	depends on BR2_PACKAGE_HAS_LIBGBM
	depends on BR2_PACKAGE_HAS_UDEV # libudev-zero
	select BR2_PACKAGE_LIBDRM
	select BR2_PACKAGE_ALSA_LIB
	select BR2_PACKAGE_ZLIB
	help
	  RetroArch on KMS/DRM with EGL and OpenGL ES 3, ALSA and
	  libudev (libudev-zero); no X11, Wayland, Qt or PulseAudio.
	  The version is the Android build's; Thimsy's patches live
	  in linux/gpl/patches/retroarch/. GPL-3.0.

	  https://github.com/libretro/RetroArch

comment "retroarch needs a toolchain w/ C++, threads"
	depends on !BR2_INSTALL_LIBSTDCPP || !BR2_TOOLCHAIN_HAS_THREADS

comment "retroarch needs EGL, OpenGL ES, GBM and libudev"
	depends on !BR2_PACKAGE_HAS_LIBEGL || !BR2_PACKAGE_HAS_LIBGLES || \
		!BR2_PACKAGE_HAS_LIBGBM || !BR2_PACKAGE_HAS_UDEV
```

## linux/package/scummvm/Config.in
```kconfig
config BR2_PACKAGE_SCUMMVM
	bool "scummvm"
	depends on BR2_INSTALL_LIBSTDCPP
	depends on BR2_TOOLCHAIN_HAS_THREADS
	depends on BR2_PACKAGE_HAS_LIBGLES
	select BR2_PACKAGE_SDL2 # sdl2-compat on SDL3 when Thimsy adds it
	select BR2_PACKAGE_ZLIB
	select BR2_PACKAGE_LIBPNG
	select BR2_PACKAGE_FREETYPE
	help
	  ScummVM with its SDL back end and OpenGL ES 2, as the
	  Android app's version. GPL-3.0+.

	  https://www.scummvm.org/

comment "scummvm needs a toolchain w/ C++, threads"
	depends on !BR2_INSTALL_LIBSTDCPP || !BR2_TOOLCHAIN_HAS_THREADS

comment "scummvm needs OpenGL ES"
	depends on !BR2_PACKAGE_HAS_LIBGLES
```

## linux/package/thimsy-data/Config.in
```kconfig
config BR2_PACKAGE_THIMSY_DATA
	bool "thimsy-data"
	depends on BR2_PACKAGE_THIMSY_NANO
	help
	  Nano's assets, installed to /usr/share/thimsy/system/etc/
	  from an allowlist that linux/tools/assets_allowlist.py
	  generates from ASSETS.md's KEEP rows (decision I38). Nano
	  falls back where an asset is missing.

	  Licences per ASSETS.md; the controller art is CC BY-NC 4.0.
```

## linux/package/thimsy-fonts/Config.in
```kconfig
config BR2_PACKAGE_THIMSY_FONTS
	bool "thimsy-fonts"
	help
	  Fonts from upstream releases, pinned by hash, installed to
	  /usr/share/fonts/thimsy under Android's file names, as
	  replacements for DroidSans and NotoColorEmoji (plan 5.2).

	  Licences: Apache-2.0 and OFL-1.1.
```

## linux/package/thimsy-gpu-pack/Config.in
```kconfig
config BR2_PACKAGE_THIMSY_GPU_PACK
	bool "thimsy-gpu-pack"
	depends on BR2_PACKAGE_MESA3D
	select BR2_PACKAGE_HOST_EROFS_UTILS
	help
	  Packs the driver files of this tree's Mesa build into one
	  EROFS image per driver set, gpu-<driver>.erofs. When a card
	  is put together, the family's pack is unpacked over the
	  tier root into that card's root image (post-image.d/
	  10-erofs.sh, decisions D25 and G8-2); nothing is mounted
	  at boot.

if BR2_PACKAGE_THIMSY_GPU_PACK

config BR2_PACKAGE_THIMSY_GPU_PACK_PANFROST
	bool "gpu-panfrost"
	depends on BR2_PACKAGE_MESA3D_GALLIUM_DRIVER_PANFROST
	help
	  Panfrost (Mali Midgard, Bifrost and Valhall), OpenGL ES.

config BR2_PACKAGE_THIMSY_GPU_PACK_SWRAST
	bool "gpu-swrast"
	depends on BR2_PACKAGE_MESA3D_GALLIUM_DRIVER_SWRAST
	help
	  Software rendering (softpipe, no LLVM), for QEMU's
	  virtio-gpu without virgl (decision I8).

endif
```

## linux/package/thimsy-nano/Config.in
```kconfig
config BR2_PACKAGE_THIMSY_NANO
	bool "thimsy-nano"
	depends on BR2_INSTALL_LIBSTDCPP
	depends on BR2_TOOLCHAIN_HAS_THREADS
	depends on BR2_TOOLCHAIN_GCC_AT_LEAST_7 # C++17
	depends on BR2_PACKAGE_HAS_LIBEGL
	depends on BR2_PACKAGE_HAS_LIBGLES
	depends on BR2_PACKAGE_HAS_LIBGBM
	select BR2_PACKAGE_LIBTHIMSY
	select BR2_PACKAGE_LIBDRM
	select BR2_PACKAGE_FREETYPE
	select BR2_PACKAGE_LIBPNG
	select BR2_PACKAGE_JPEG
	select BR2_PACKAGE_LIBWEBP
	select BR2_PACKAGE_LIBWEBP_DEMUX # animated WebP (nano/CMakeLists.txt)
	select BR2_PACKAGE_GIFLIB
	select BR2_PACKAGE_ZLIB
	select BR2_PACKAGE_TINYXML2
	select BR2_PACKAGE_LIBCURL
	select BR2_PACKAGE_OPENSSL
	select BR2_PACKAGE_ALSA_LIB
	help
	  Nano, Thimsy's frontend, on DRM/KMS with GBM, EGL and
	  OpenGL ES, built with CMake from a git archive of the
	  repository's nano/ at HEAD (IMPLEMENTATION.md E.1, E.3).

	  Licence: Apache-2.0, GPL-2.0+ (NanoOskKanji.h, from
	  SKK-JISYO), Zlib (nanosvg), MIT (rcheevos); see
	  nano/NOTICE.

if BR2_PACKAGE_THIMSY_NANO

config BR2_PACKAGE_THIMSY_NANO_SCRAPE
	bool "thimsy-nano-scrape"
	default y
	help
	  The scraper as its own process, started by thimsy-session
	  when Nano asks for a scrape (decision I25).

endif

comment "thimsy-nano needs a toolchain w/ C++, threads, gcc >= 7"
	depends on !BR2_INSTALL_LIBSTDCPP || !BR2_TOOLCHAIN_HAS_THREADS || \
		!BR2_TOOLCHAIN_GCC_AT_LEAST_7

comment "thimsy-nano needs EGL, OpenGL ES and GBM"
	depends on !BR2_PACKAGE_HAS_LIBEGL || !BR2_PACKAGE_HAS_LIBGLES || \
		!BR2_PACKAGE_HAS_LIBGBM
```

## linux/package/thimsy-padd/Config.in
```kconfig
config BR2_PACKAGE_THIMSY_PADD
	bool "thimsy-padd"
	depends on BR2_INSTALL_LIBSTDCPP
	depends on BR2_TOOLCHAIN_HAS_THREADS
	depends on BR2_TOOLCHAIN_GCC_AT_LEAST_7 # C++17
	select BR2_PACKAGE_LIBTHIMSY
	help
	  Reads the device's input nodes and presents one virtual
	  gamepad, "Thimsy Gamepad", through uinput (decisions D23
	  and I13; IMPLEMENTATION.md F.2). The kernel needs
	  CONFIG_INPUT_UINPUT. MIT.

comment "thimsy-padd needs a toolchain w/ C++, threads, gcc >= 7"
	depends on !BR2_INSTALL_LIBSTDCPP || !BR2_TOOLCHAIN_HAS_THREADS || \
		!BR2_TOOLCHAIN_GCC_AT_LEAST_7
```

## linux/package/thimsy-session/Config.in
```kconfig
config BR2_PACKAGE_THIMSY_SESSION
	bool "thimsy-session"
	depends on BR2_INSTALL_LIBSTDCPP
	depends on BR2_TOOLCHAIN_HAS_THREADS
	depends on BR2_TOOLCHAIN_GCC_AT_LEAST_7 # C++17
	select BR2_PACKAGE_LIBTHIMSY
	help
	  Starts and supervises Nano; drives, hotplug, power and
	  volume keys, sleep, the quit hotkey and the deferred start
	  of services (IMPLEMENTATION.md F.1). MIT.

	  SSH has no option here: D50ssh (board/common/rootfs-overlay)
	  decides by ro.thimsy.build.type. Dev images start dropbear
	  by default; release images only when the user turns SSH on,
	  and then key-only (decision I37).

comment "thimsy-session needs a toolchain w/ C++, threads, gcc >= 7"
	depends on !BR2_INSTALL_LIBSTDCPP || !BR2_TOOLCHAIN_HAS_THREADS || \
		!BR2_TOOLCHAIN_GCC_AT_LEAST_7
```

## linux/tests/fixtures/fit/rk3566-anbernic-rg-arc-s.its
```
/dts-v1/;

/ {
	description = "Thimsy boot FIT: rk3566 anbernic-rg-arc-s";
	#address-cells = <1>;

	images {
		kernel {
			description = "Linux kernel";
			data = /incbin/("Image.zst");
			type = "kernel";
			arch = "arm64";
			os = "linux";
			compression = "zstd";
			load = <0x02000000>;
			entry = <0x02000000>;
		};

		fdt {
			description = "rk3566-anbernic-rg-arc-s.dtb";
			data = /incbin/("rk3566-anbernic-rg-arc-s.dtb");
			type = "flat_dt";
			arch = "arm64";
			compression = "none";
		};
	};

	configurations {
		default = "conf";

		conf {
			description = "anbernic-rg-arc-s";
			kernel = "kernel";
			fdt = "fdt";
			bootargs = "init=/init rootfstype=erofs ro rootwait gpt quiet loglevel=3";
		};
	};
};
```
